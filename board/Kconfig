## board/Kconfig
```kconfig
menu "USB Host Stack"

config SOC_IMXRT1052CVL5B
    bool 
    select SOC_MIMXRT1050_SERIES
    select RT_USING_COMPONENTS_INIT
    select RT_USING_USER_MAIN
    default y

    menuconfig BSP_USING_LPUART
        bool 
        select RT_USING_SERIAL
        default y

        if BSP_USING_LPUART
            config BSP_USING_LPUART1
                bool 
                default y
        endif

    config BSP_USING_USB
    bool
    default y

    config BSP_USING_USBH
    bool
    default n

    config BSP_USING_USBH_MOUSE
        bool "Enable USB hid mouse"
        select BSP_USING_USBH
        default n

endmenu

menu "USB Device Stack"
    config BSP_USING_USBD
    bool
    default n

    config BSP_USING_USBD_VCOM
        bool "Enable USB cdc vcom"
        select BSP_USING_USBD
        default n

endmenu
```
